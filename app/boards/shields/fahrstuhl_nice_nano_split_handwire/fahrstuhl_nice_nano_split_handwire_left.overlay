#include <dt-bindings/zmk/matrix_transform.h>
#include "fahrstuhl_nice_nano_split_handwire.overlay"

&kscan0 {
    col-gpios = <&gpio0 6 (GPIO_ACTIVE_HIGH)>,
                <&gpio0 8 (GPIO_ACTIVE_HIGH)>,
                <&gpio1 7 (GPIO_ACTIVE_HIGH)>,
                <&gpio0 17 (GPIO_ACTIVE_HIGH)>,
                <&gpio0 20 (GPIO_ACTIVE_HIGH)>,
                <&gpio0 22 (GPIO_ACTIVE_HIGH)>;
};
