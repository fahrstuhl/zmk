## app/boards/seeed/xiao_ble/board.yml
```yaml
board:
  extend: xiao_ble
  variants:
    - name: zmk
      qualifier: nrf52840
    - name: plus_zmk
      qualifier: nrf52840
```

## app/boards/shields/fahrstuhl_feather_m0_handwire/Kconfig.defconfig
```kconfig
if SHIELD_FAHRSTUHL_FEATHER_M0_HANDWIRE

config ZMK_KEYBOARD_NAME
	default "Fahrstuhl's Handwire"

config ZMK_USB
	default y

endif
```

## app/boards/shields/fahrstuhl_feather_m0_handwire/Kconfig.shield
```kconfig
# Copyright (c) 2019 Linaro Limited
# SPDX-License-Identifier: MIT

config SHIELD_FAHRSTUHL_FEATHER_M0_HANDWIRE
	def_bool $(shields_list_contains,fahrstuhl_feather_m0_handwire)
```

## app/boards/shields/fahrstuhl_nice_nano_split_handwire/Kconfig.defconfig
```kconfig
if SHIELD_FAHRSTUHL_NICE_NANO_SPLIT_HANDWIRE_LEFT

config ZMK_KEYBOARD_NAME
	default "Fahrstuhl's KB Left"

config ZMK_SPLIT_BLE_ROLE_CENTRAL
    default y

config ZMK_SPLIT
    default y

config ZMK_USB
	default y

endif

if SHIELD_FAHRSTUHL_NICE_NANO_SPLIT_HANDWIRE_RIGHT

config ZMK_KEYBOARD_NAME
	default "Fahrstuhl's KB Right"

config ZMK_SPLIT_BLE_ROLE_CENTRAL
    default n

config ZMK_SPLIT
    default y

config ZMK_USB
	default y

endif
```

## app/boards/shields/fahrstuhl_nice_nano_split_handwire/Kconfig.shield
```kconfig
# Copyright (c) 2019 Linaro Limited
# SPDX-License-Identifier: MIT

config SHIELD_FAHRSTUHL_NICE_NANO_SPLIT_HANDWIRE_LEFT
	def_bool $(shields_list_contains,fahrstuhl_nice_nano_split_handwire_left)

config SHIELD_FAHRSTUHL_NICE_NANO_SPLIT_HANDWIRE_RIGHT
	def_bool $(shields_list_contains,fahrstuhl_nice_nano_split_handwire_right)
```

## app/boards/shields/tester_xiao_plus/Kconfig.shield
```kconfig
config SHIELD_TESTER_XIAO_PLUS
    def_bool $(shields_list_contains,tester_xiao_plus)
```
